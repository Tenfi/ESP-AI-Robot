## example/bilibili_fans/main/Kconfig.projbuild
```kconfig
menu "Example Configuration"

    config BILIBILI_ACCOUNT_NUMBER
        string "BILIBILI ACCOUNT NUMBER"
        default "3493296718482287"
        help
            bilibili account number to get your fans count
    
    config BILIBILI_ACCOUNT_NAME
        string "BILIBILI ACCOUNT NAME"
        default "ESP_Friends"
        help
            bilibili account name to show on screen

    config EXAMPLE_WIFI_SSID
        string "SSID"
        default "ssid"
        help
            SSID of the WiFi network to connect to

    config EXAMPLE_WIFI_PASSWORD
        string "Password"
        default "password"
        help
            Password of the WiFi network to connect to

endmenu
```

## example/factory_demo_v1/main/Kconfig.projbuild
```kconfig
menu "Example Configuration"

    config BAIDU_AUDIO_ACCESS_TOKEN
        string "BAIDU AUDIO ACCESS TOKEN"
        default "token"
        help
            ACCESS TOKEN for tts and stt

    config BAIDU_LLM_ACCESS_TOKEN
        string "BAIDU LLM ACCESS TOKEN"
        default "token"
        help
            ACCESS TOKEN for baidu LLM

    config QWEATHER_REQUEST_KEY
        string "QWEATHER REQUEST KEY"
        default "key"
        help
            Get weather information from Qweatehr server

    config EXAMPLE_WIFI_SSID
        string "SSID"
        default "ssid"
        help
            SSID of the WiFi network to connect to

    config EXAMPLE_WIFI_PASSWORD
        string "Password"
        default "password"
        help
            Password of the WiFi network to connect to

endmenu
```

## example/tank/c2_tracked_chassis/sdkconfig.defaults
```kconfig
CONFIG_IDF_TARGET="esp32c2"
# Bypass a bug. Use 26M XTAL Freq
CONFIG_XTAL_FREQ_26=y
```

## example/usb_extend_screen_s3/sdkconfig.defaults.esp32s3
```kconfig
#
# Compiler options
#
CONFIG_COMPILER_OPTIMIZATION_PERF=y

#
# ESP PSRAM
#
CONFIG_SPIRAM=y
CONFIG_SPIRAM_MODE_OCT=y
CONFIG_SPIRAM_FETCH_INSTRUCTIONS=y
CONFIG_SPIRAM_RODATA=y

#
# Serial flasher config
#
CONFIG_ESPTOOLPY_FLASHMODE_QIO=y


CONFIG_IDF_EXPERIMENTAL_FEATURES=y

#
# Serial flasher config
#
CONFIG_ESPTOOLPY_FLASHFREQ_120M=y

#
# SPI RAM config
#
CONFIG_SPIRAM_SPEED_120M=y

#
# Cache config
#
CONFIG_ESP32S3_DATA_CACHE_LINE_64B=y
#
# Compiler options
#
CONFIG_COMPILER_OPTIMIZATION_PERF=y

#
# ESP PSRAM
#
CONFIG_SPIRAM=y
CONFIG_SPIRAM_MODE_OCT=y
CONFIG_SPIRAM_FETCH_INSTRUCTIONS=y
CONFIG_SPIRAM_RODATA=y

#
# Serial flasher config
#
CONFIG_ESPTOOLPY_FLASHMODE_QIO=y


CONFIG_IDF_EXPERIMENTAL_FEATURES=y

#
# Serial flasher config
#
CONFIG_ESPTOOLPY_FLASHFREQ_120M=y

#
# SPI RAM config
#
CONFIG_SPIRAM_SPEED_120M=y

#
# Cache config
#
CONFIG_ESP32S3_DATA_CACHE_LINE_64B=y
```
